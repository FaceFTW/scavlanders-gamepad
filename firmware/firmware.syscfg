/**
 * These arguments were used when this file was generated. They will be automatically applied on subsequent loads
 * via the GUI or CLI. Run CLI with '--help' for additional information on how to override these arguments.
 * @cliArgs --board "/ti/boards/MSP_EXP432P401R" --product "simplelink_msp432e4_sdk@3.20.00.10" --product "simplelink_msp432p4_sdk@3.40.01.02"
 * @versions {"data":"2020090214","timestamp":"2020090214","tool":"1.6.0+1543","templates":"2020090214"}
 */

/**
 * Import the modules used in this configuration.
 */
const ADC    = scripting.addModule("/ti/drivers/ADC", {}, false);
const ADC1   = ADC.addInstance();
const ADC2   = ADC.addInstance();
const ADC3   = ADC.addInstance();
const ADC4   = ADC.addInstance();
const DMA    = scripting.addModule("/ti/drivers/DMA");
const GPIO   = scripting.addModule("/ti/drivers/GPIO");
const GPIO1  = GPIO.addInstance();
const GPIO2  = GPIO.addInstance();
const GPIO3  = GPIO.addInstance();
const GPIO4  = GPIO.addInstance();
const GPIO5  = GPIO.addInstance();
const GPIO6  = GPIO.addInstance();
const GPIO7  = GPIO.addInstance();
const GPIO8  = GPIO.addInstance();
const GPIO9  = GPIO.addInstance();
const GPIO10 = GPIO.addInstance();
const GPIO11 = GPIO.addInstance();
const GPIO12 = GPIO.addInstance();
const GPIO13 = GPIO.addInstance();
const GPIO14 = GPIO.addInstance();
const GPIO15 = GPIO.addInstance();
const GPIO16 = GPIO.addInstance();
const GPIO17 = GPIO.addInstance();
const GPIO18 = GPIO.addInstance();
const GPIO19 = GPIO.addInstance();
const GPIO20 = GPIO.addInstance();
const GPIO21 = GPIO.addInstance();
const GPIO22 = GPIO.addInstance();
const GPIO23 = GPIO.addInstance();
const GPIO24 = GPIO.addInstance();
const GPIO25 = GPIO.addInstance();
const GPIO26 = GPIO.addInstance();
const GPIO27 = GPIO.addInstance();
const GPIO28 = GPIO.addInstance();
const SPI    = scripting.addModule("/ti/drivers/SPI", {}, false);
const SPI1   = SPI.addInstance();

/**
 * Write custom configuration values to the imported modules.
 */
ADC1.$name              = "Left_Joy_X";
ADC1.referenceVoltage   = "External";
ADC1.adc.$assign        = "ADC14";
ADC1.adc.adcPin.$assign = "expansion.4";

ADC2.referenceVoltage   = "External";
ADC2.$name              = "Left_Joy_Y";
ADC2.adc.$assign        = "ADC14";
ADC2.adc.adcPin.$assign = "expansion.2";

ADC3.$name              = "Right_Joy_X";
ADC3.referenceVoltage   = "External";
ADC3.adc.$assign        = "ADC14";
ADC3.adc.adcPin.$assign = "expansion.1";

ADC4.$name              = "Right_Joy_Y";
ADC4.referenceVoltage   = "External";
ADC4.adc.$assign        = "ADC14";
ADC4.adc.adcPin.$assign = "expansion.5";

DMA.dmaErrorFunction = "dmaErrorHwi";

GPIO1.$name            = "Button_A";
GPIO1.pull             = "Pull Up";
GPIO1.interruptTrigger = "Rising Edge";
GPIO1.callbackFunction = "NULL";
GPIO1.gpioPin.$assign  = "boosterpack.24";

GPIO2.$name            = "Button_B";
GPIO2.pull             = "Pull Up";
GPIO2.interruptTrigger = "Rising Edge";
GPIO2.callbackFunction = "NULL";
GPIO2.gpioPin.$assign  = "boosterpack.5";

GPIO3.$name            = "Button_X";
GPIO3.pull             = "Pull Up";
GPIO3.interruptTrigger = "Rising Edge";
GPIO3.callbackFunction = "NULL";
GPIO3.gpioPin.$assign  = "boosterpack.25";

GPIO4.$name            = "Button_Y";
GPIO4.pull             = "Pull Up";
GPIO4.interruptTrigger = "Rising Edge";
GPIO4.callbackFunction = "NULL";
GPIO4.gpioPin.$assign  = "boosterpack.6";

GPIO5.$name            = "Button_DPad_Up";
GPIO5.pull             = "Pull Up";
GPIO5.interruptTrigger = "Rising Edge";
GPIO5.callbackFunction = "NULL";
GPIO5.gpioPin.$assign  = "boosterpack.26";

GPIO6.$name            = "Button_DPad_Down";
GPIO6.pull             = "Pull Up";
GPIO6.interruptTrigger = "Rising Edge";
GPIO6.callbackFunction = "NULL";
GPIO6.gpioPin.$assign  = "boosterpack.27";

GPIO7.$name            = "Button_DPad_Left";
GPIO7.pull             = "Pull Up";
GPIO7.interruptTrigger = "Rising Edge";
GPIO7.callbackFunction = "NULL";
GPIO7.gpioPin.$assign  = "boosterpack.8";

GPIO8.$name            = "Button_DPad_Right";
GPIO8.pull             = "Pull Up";
GPIO8.interruptTrigger = "Rising Edge";
GPIO8.callbackFunction = "NULL";
GPIO8.gpioPin.$assign  = "boosterpack.28";

GPIO9.$name            = "Button_Start";
GPIO9.interruptTrigger = "Rising Edge";
GPIO9.pull             = "Pull Up";
GPIO9.callbackFunction = "NULL";
GPIO9.gpioPin.$assign  = "expansion.14";

GPIO10.$name            = "Button_Select";
GPIO10.interruptTrigger = "Rising Edge";
GPIO10.callbackFunction = "NULL";
GPIO10.gpioPin.$assign  = "boosterpack.10";

GPIO11.$name            = "Button_Pairing";
GPIO11.pull             = "Pull Up";
GPIO11.interruptTrigger = "Rising Edge";
GPIO11.callbackFunction = "NULL";
GPIO11.gpioPin.$assign  = "expansion.11";

GPIO12.$name            = "Trigger_Left";
GPIO12.interruptTrigger = "Rising Edge";
GPIO12.pull             = "Pull Up";
GPIO12.callbackFunction = "NULL";
GPIO12.gpioPin.$assign  = "boosterpack.9";

GPIO13.$name            = "Trigger_Right";
GPIO13.interruptTrigger = "Rising Edge";
GPIO13.pull             = "Pull Up";
GPIO13.callbackFunction = "NULL";
GPIO13.gpioPin.$assign  = "boosterpack.36";

GPIO14.$name           = "LCD_RS";
GPIO14.mode            = "Output";
GPIO14.outputStrength  = "High";
GPIO14.gpioPin.$assign = "expansion.18";

GPIO15.$name           = "LCD_EN";
GPIO15.mode            = "Output";
GPIO15.outputStrength  = "High";
GPIO15.gpioPin.$assign = "expansion.15";

GPIO16.$name           = "LCD_D4";
GPIO16.mode            = "Output";
GPIO16.outputStrength  = "High";
GPIO16.gpioPin.$assign = "expansion.27";

GPIO17.$name           = "LCD_D5";
GPIO17.mode            = "Output";
GPIO17.outputStrength  = "High";
GPIO17.gpioPin.$assign = "expansion.28";

GPIO18.$name           = "LCD_D6";
GPIO18.mode            = "Output";
GPIO18.outputStrength  = "High";
GPIO18.gpioPin.$assign = "expansion.29";

GPIO19.$name           = "LCD_D7";
GPIO19.mode            = "Output";
GPIO19.outputStrength  = "High";
GPIO19.gpioPin.$assign = "expansion.30";

GPIO20.$name              = "MSP_EXP432P401R_SRDY";
GPIO20.mode               = "Output";
GPIO20.outputStrength     = "High";
GPIO20.initialOutputState = "High";
GPIO20.gpioPin.$assign    = "boosterpack.19";

GPIO21.$name            = "MSP_EXP432P401R_MRDY";
GPIO21.pull             = "Pull Up";
GPIO21.interruptTrigger = "Rising Edge";
GPIO21.callbackFunction = "NULL";

GPIO22.$name            = "MSP_EXP432P401R_SENSORBP_INT1";
GPIO22.pull             = "Pull Down";
GPIO22.interruptTrigger = "Rising Edge";
GPIO22.callbackFunction = "NULL";

GPIO23.$name              = "MSP_EXP432P401R_SPI_CS";
GPIO23.mode               = "Output";
GPIO23.outputStrength     = "High";
GPIO23.initialOutputState = "High";

GPIO24.$hardware      = system.deviceData.board.components.LED1_RED;
GPIO24.$name          = "MSP_EXP432P401R_LED1";
GPIO24.outputStrength = "High";

GPIO25.$hardware      = system.deviceData.board.components.LED2_RED;
GPIO25.$name          = "MSP_EXP432P401R_LED_RED";
GPIO25.outputStrength = "High";

GPIO26.$hardware      = system.deviceData.board.components.LED2_GREEN;
GPIO26.$name          = "MSP_EXP432P401R_LED_GREEN";
GPIO26.outputStrength = "High";

GPIO27.$name          = "MSP_EXP432P401R_LED_BLUE";
GPIO27.$hardware      = system.deviceData.board.components.LED2_BLUE;
GPIO27.outputStrength = "High";

GPIO28.$name                         = "MSP_EXP432P401R_RESET";
GPIO28.mode                          = "Output";
GPIO28.outputStrength                = "High";
GPIO28.initialOutputState            = "High";
GPIO28.gpioPin.$assignAllowConflicts = "boosterpack.35";

const Power                   = scripting.addModule("/ti/drivers/Power", {}, false);
Power.performanceLevel3.$name = "ti_drivers_power_PowerMSP432PerfLevels0";
Power.performanceLevel2.$name = "ti_drivers_power_PowerMSP432PerfLevels1";
Power.performanceLevel1.$name = "ti_drivers_power_PowerMSP432PerfLevels2";
Power.performanceLevel0.$name = "ti_drivers_power_PowerMSP432PerfLevels3";

SPI1.duplex                         = "Master TX Only";
SPI1.$name                          = "LED_Matrix";
SPI1.spi.$assign                    = "EUSCI_A3";
SPI1.spi.sclkPin.$assign            = "expansion.20";
SPI1.spi.mosiPin.$assign            = "expansion.22";
SPI1.spi.dmaTxChannel.$assign       = "DMA_CH6";
SPI1.spi.dmaInterruptNumber.$assign = "DMA_INT0";

/**
 * Pinmux solution for unlocked pins/peripherals. This ensures that minor changes to the automatic solver in a future
 * version of the tool will not impact the pinmux you originally saw.  These lines can be completely deleted in order to
 * re-solve from scratch.
 */
GPIO21.gpioPin.$suggestSolution = "boosterpack.15";
GPIO22.gpioPin.$suggestSolution = "boosterpack.7";
GPIO23.gpioPin.$suggestSolution = "boosterpack.14";
GPIO24.gpioPin.$suggestSolution = "P1.0.GPIO/EUSCI_A0_SPI.STE";
GPIO25.gpioPin.$suggestSolution = "P2.0.GPIO/EUSCI_A1_SPI.STE";
GPIO26.gpioPin.$suggestSolution = "P2.1.GPIO/EUSCI_A1_SPI.CLK";
GPIO27.gpioPin.$suggestSolution = "P2.2.GPIO/EUSCI_A1_UART.RXD/EUSCI_A1_SPI.SOMI";
